## components/kitzune_board/Kconfig.projbuild
```kconfig
menu "My Audio Board"

choice CUSTOMER_AUDIO_BOARD
    prompt "Kitzune Audio Board"
    default KITZUNE_V1_0
    help
        Select an audio board to use with the ESP-ADF

config KITZUNE_V1_0
    bool "Kitzune v1.0"

endchoice

endmenu
```
